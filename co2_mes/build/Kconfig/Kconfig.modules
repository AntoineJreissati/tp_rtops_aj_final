## co2_mes/build/Kconfig/Kconfig.modules
```kconfig
menu "sensirion_drivers (/home/aj/TpRTOS/modules/sensirion_zephyr_drivers)"
osource "/home/aj/TpRTOS/modules/sensirion_zephyr_drivers/Kconfig"
config ZEPHYR_SENSIRION_DRIVERS_MODULE
	bool
	default y
endmenu
menu "cmsis (/home/aj/TpRTOS/modules/hal/cmsis)"
osource "$(ZEPHYR_CMSIS_KCONFIG)"
config ZEPHYR_CMSIS_MODULE
	bool
	default y
endmenu
config ZEPHYR_HAL_STM32_MODULE
	bool
	default y

config ZEPHYR_HAL_STM32_MODULE_BLOBS
	bool
```

## co2_mes/build/Kconfig/arch/Kconfig
```kconfig
# Load Zephyr Arch Kconfig descriptions.
osource "/home/aj/TpRTOS/zephyr/arch/x86/Kconfig"
osource "/home/aj/TpRTOS/zephyr/arch/xtensa/Kconfig"
osource "/home/aj/TpRTOS/zephyr/arch/sparc/Kconfig"
osource "/home/aj/TpRTOS/zephyr/arch/riscv/Kconfig"
osource "/home/aj/TpRTOS/zephyr/arch/posix/Kconfig"
osource "/home/aj/TpRTOS/zephyr/arch/nios2/Kconfig"
osource "/home/aj/TpRTOS/zephyr/arch/mips/Kconfig"
osource "/home/aj/TpRTOS/zephyr/arch/arm64/Kconfig"
osource "/home/aj/TpRTOS/zephyr/arch/arm/Kconfig"
osource "/home/aj/TpRTOS/zephyr/arch/arc/Kconfig"
```

## co2_mes/build/Kconfig/boards/Kconfig.defconfig
```kconfig
# Load Zephyr board defconfig descriptions.
osource "/home/aj/TpRTOS/zephyr/boards/st/nucleo_wl55jc/Kconfig.defconfig"
```

## co2_mes/build/Kconfig/boards/Kconfig.nucleo_wl55jc
```kconfig
# Load board Kconfig descriptions.
osource "/home/aj/TpRTOS/zephyr/boards/st/nucleo_wl55jc/Kconfig.nucleo_wl55jc"
```

## co2_mes/build/Kconfig/boards/Kconfig.sysbuild
```kconfig
# Load Sysbuild board Kconfig descriptions.
osource "/home/aj/TpRTOS/zephyr/boards/st/nucleo_wl55jc/Kconfig.sysbuild"
```

## co2_mes/build/Kconfig/soc/Kconfig
```kconfig
# Load Zephyr SoC Kconfig descriptions.
osource "/home/aj/TpRTOS/zephyr/soc/xlnx/zynqmp/Kconfig"
osource "/home/aj/TpRTOS/zephyr/soc/xlnx/zynq7000/Kconfig"
osource "/home/aj/TpRTOS/zephyr/soc/xen/Kconfig"
osource "/home/aj/TpRTOS/zephyr/soc/ti/simplelink/Kconfig"
osource "/home/aj/TpRTOS/zephyr/soc/ti/lm3s6965/Kconfig"
osource "/home/aj/TpRTOS/zephyr/soc/ti/k3/Kconfig"
osource "/home/aj/TpRTOS/zephyr/soc/telink/tlsr/Kconfig"
osource "/home/aj/TpRTOS/zephyr/soc/starfive/jh71xx/Kconfig"
osource "/home/aj/TpRTOS/zephyr/soc/st/stm32/Kconfig"
osource "/home/aj/TpRTOS/zephyr/soc/snps/qemu_arc/Kconfig"
osource "/home/aj/TpRTOS/zephyr/soc/snps/nsim/arc_v/Kconfig"
osource "/home/aj/TpRTOS/zephyr/soc/snps/nsim/arc_classic/Kconfig"
osource "/home/aj/TpRTOS/zephyr/soc/snps/hsdk4xd/Kconfig"
osource "/home/aj/TpRTOS/zephyr/soc/snps/hsdk/Kconfig"
osource "/home/aj/TpRTOS/zephyr/soc/snps/emsk/Kconfig"
osource "/home/aj/TpRTOS/zephyr/soc/snps/emsdp/Kconfig"
osource "/home/aj/TpRTOS/zephyr/soc/snps/arc_iot/Kconfig"
osource "/home/aj/TpRTOS/zephyr/soc/silabs/Kconfig"
osource "/home/aj/TpRTOS/zephyr/soc/sifive/sifive_freedom/Kconfig"
osource "/home/aj/TpRTOS/zephyr/soc/sensry/Kconfig"
osource "/home/aj/TpRTOS/zephyr/soc/rockchip/Kconfig"
osource "/home/aj/TpRTOS/zephyr/soc/renode/riscv_virtual/Kconfig"
osource "/home/aj/TpRTOS/zephyr/soc/renode/cortex_r8_virtual/Kconfig"
osource "/home/aj/TpRTOS/zephyr/soc/renesas/smartbond/Kconfig"
osource "/home/aj/TpRTOS/zephyr/soc/renesas/rzt2m/Kconfig"
osource "/home/aj/TpRTOS/zephyr/soc/renesas/rcar/Kconfig"
osource "/home/aj/TpRTOS/zephyr/soc/renesas/ra/Kconfig"
osource "/home/aj/TpRTOS/zephyr/soc/raspberrypi/Kconfig"
osource "/home/aj/TpRTOS/zephyr/soc/quicklogic/eos_s3/Kconfig"
osource "/home/aj/TpRTOS/zephyr/soc/qemu/virt_riscv/Kconfig"
osource "/home/aj/TpRTOS/zephyr/soc/qemu/malta/Kconfig"
osource "/home/aj/TpRTOS/zephyr/soc/openisa/rv32m1/Kconfig"
osource "/home/aj/TpRTOS/zephyr/soc/nxp/s32/Kconfig"
osource "/home/aj/TpRTOS/zephyr/soc/nxp/rw/Kconfig"
osource "/home/aj/TpRTOS/zephyr/soc/nxp/mcx/Kconfig"
osource "/home/aj/TpRTOS/zephyr/soc/nxp/lpc/Kconfig"
osource "/home/aj/TpRTOS/zephyr/soc/nxp/layerscape/Kconfig"
osource "/home/aj/TpRTOS/zephyr/soc/nxp/kinetis/Kconfig"
osource "/home/aj/TpRTOS/zephyr/soc/nxp/imxrt/Kconfig"
osource "/home/aj/TpRTOS/zephyr/soc/nxp/imx/Kconfig"
osource "/home/aj/TpRTOS/zephyr/soc/nuvoton/numicro/Kconfig"
osource "/home/aj/TpRTOS/zephyr/soc/nuvoton/numaker/Kconfig"
osource "/home/aj/TpRTOS/zephyr/soc/nuvoton/npcx/Kconfig"
osource "/home/aj/TpRTOS/zephyr/soc/nuvoton/npcm/Kconfig"
osource "/home/aj/TpRTOS/zephyr/soc/nordic/Kconfig"
osource "/home/aj/TpRTOS/zephyr/soc/neorv32/Kconfig"
osource "/home/aj/TpRTOS/zephyr/soc/native/inf_clock/Kconfig"
osource "/home/aj/TpRTOS/zephyr/soc/microchip/miv/Kconfig"
osource "/home/aj/TpRTOS/zephyr/soc/microchip/mec/Kconfig"
osource "/home/aj/TpRTOS/zephyr/soc/mediatek/mtk_adsp/Kconfig"
osource "/home/aj/TpRTOS/zephyr/soc/lowrisc/opentitan/Kconfig"
osource "/home/aj/TpRTOS/zephyr/soc/litex/litex_vexriscv/Kconfig"
osource "/home/aj/TpRTOS/zephyr/soc/ite/ec/Kconfig"
osource "/home/aj/TpRTOS/zephyr/soc/intel/raptor_lake/Kconfig"
osource "/home/aj/TpRTOS/zephyr/soc/intel/lakemont/Kconfig"
osource "/home/aj/TpRTOS/zephyr/soc/intel/intel_socfpga_std/Kconfig"
osource "/home/aj/TpRTOS/zephyr/soc/intel/intel_socfpga/Kconfig"
osource "/home/aj/TpRTOS/zephyr/soc/intel/intel_niosv/Kconfig"
osource "/home/aj/TpRTOS/zephyr/soc/intel/intel_ish/Kconfig"
osource "/home/aj/TpRTOS/zephyr/soc/intel/intel_adsp/Kconfig"
osource "/home/aj/TpRTOS/zephyr/soc/intel/elkhart_lake/Kconfig"
osource "/home/aj/TpRTOS/zephyr/soc/intel/atom/Kconfig"
osource "/home/aj/TpRTOS/zephyr/soc/intel/apollo_lake/Kconfig"
osource "/home/aj/TpRTOS/zephyr/soc/intel/alder_lake/Kconfig"
osource "/home/aj/TpRTOS/zephyr/soc/infineon/cat3/Kconfig"
osource "/home/aj/TpRTOS/zephyr/soc/infineon/cat1b/Kconfig"
osource "/home/aj/TpRTOS/zephyr/soc/infineon/cat1a/Kconfig"
osource "/home/aj/TpRTOS/zephyr/soc/gd/gd32/Kconfig"
osource "/home/aj/TpRTOS/zephyr/soc/gaisler/leon3/Kconfig"
osource "/home/aj/TpRTOS/zephyr/soc/gaisler/gr716a/Kconfig"
osource "/home/aj/TpRTOS/zephyr/soc/espressif/Kconfig"
osource "/home/aj/TpRTOS/zephyr/soc/ene/kb1200/Kconfig"
osource "/home/aj/TpRTOS/zephyr/soc/efinix/sapphire/Kconfig"
osource "/home/aj/TpRTOS/zephyr/soc/cdns/xtensa_sample_controller/Kconfig"
osource "/home/aj/TpRTOS/zephyr/soc/cdns/sample_controller32/Kconfig"
osource "/home/aj/TpRTOS/zephyr/soc/cdns/dc233c/Kconfig"
osource "/home/aj/TpRTOS/zephyr/soc/brcm/bcmvk/Kconfig"
osource "/home/aj/TpRTOS/zephyr/soc/brcm/bcm2712/Kconfig"
osource "/home/aj/TpRTOS/zephyr/soc/brcm/bcm2711/Kconfig"
osource "/home/aj/TpRTOS/zephyr/soc/atmel/sam0/Kconfig"
osource "/home/aj/TpRTOS/zephyr/soc/atmel/sam/Kconfig"
osource "/home/aj/TpRTOS/zephyr/soc/aspeed/Kconfig"
osource "/home/aj/TpRTOS/zephyr/soc/arm/Kconfig"
osource "/home/aj/TpRTOS/zephyr/soc/arm/beetle/Kconfig"
osource "/home/aj/TpRTOS/zephyr/soc/andestech/Kconfig"
osource "/home/aj/TpRTOS/zephyr/soc/ambiq/Kconfig"
osource "/home/aj/TpRTOS/zephyr/soc/altr/zephyr_nios2f/Kconfig"
osource "/home/aj/TpRTOS/zephyr/soc/altr/qemu_nios2/Kconfig"
osource "/home/aj/TpRTOS/zephyr/soc/adi/max32/Kconfig"
```

## co2_mes/build/Kconfig/soc/Kconfig.sysbuild
```kconfig
# Load Sysbuild SoC Kconfig descriptions.
osource "/home/aj/TpRTOS/zephyr/soc/xlnx/zynqmp/Kconfig.sysbuild"
osource "/home/aj/TpRTOS/zephyr/soc/xlnx/zynq7000/Kconfig.sysbuild"
osource "/home/aj/TpRTOS/zephyr/soc/xen/Kconfig.sysbuild"
osource "/home/aj/TpRTOS/zephyr/soc/ti/simplelink/Kconfig.sysbuild"
osource "/home/aj/TpRTOS/zephyr/soc/ti/lm3s6965/Kconfig.sysbuild"
osource "/home/aj/TpRTOS/zephyr/soc/ti/k3/Kconfig.sysbuild"
osource "/home/aj/TpRTOS/zephyr/soc/telink/tlsr/Kconfig.sysbuild"
osource "/home/aj/TpRTOS/zephyr/soc/starfive/jh71xx/Kconfig.sysbuild"
osource "/home/aj/TpRTOS/zephyr/soc/st/stm32/Kconfig.sysbuild"
osource "/home/aj/TpRTOS/zephyr/soc/snps/qemu_arc/Kconfig.sysbuild"
osource "/home/aj/TpRTOS/zephyr/soc/snps/nsim/arc_v/Kconfig.sysbuild"
osource "/home/aj/TpRTOS/zephyr/soc/snps/nsim/arc_classic/Kconfig.sysbuild"
osource "/home/aj/TpRTOS/zephyr/soc/snps/hsdk4xd/Kconfig.sysbuild"
osource "/home/aj/TpRTOS/zephyr/soc/snps/hsdk/Kconfig.sysbuild"
osource "/home/aj/TpRTOS/zephyr/soc/snps/emsk/Kconfig.sysbuild"
osource "/home/aj/TpRTOS/zephyr/soc/snps/emsdp/Kconfig.sysbuild"
osource "/home/aj/TpRTOS/zephyr/soc/snps/arc_iot/Kconfig.sysbuild"
osource "/home/aj/TpRTOS/zephyr/soc/silabs/Kconfig.sysbuild"
osource "/home/aj/TpRTOS/zephyr/soc/sifive/sifive_freedom/Kconfig.sysbuild"
osource "/home/aj/TpRTOS/zephyr/soc/sensry/Kconfig.sysbuild"
osource "/home/aj/TpRTOS/zephyr/soc/rockchip/Kconfig.sysbuild"
osource "/home/aj/TpRTOS/zephyr/soc/renode/riscv_virtual/Kconfig.sysbuild"
osource "/home/aj/TpRTOS/zephyr/soc/renode/cortex_r8_virtual/Kconfig.sysbuild"
osource "/home/aj/TpRTOS/zephyr/soc/renesas/smartbond/Kconfig.sysbuild"
osource "/home/aj/TpRTOS/zephyr/soc/renesas/rzt2m/Kconfig.sysbuild"
osource "/home/aj/TpRTOS/zephyr/soc/renesas/rcar/Kconfig.sysbuild"
osource "/home/aj/TpRTOS/zephyr/soc/renesas/ra/Kconfig.sysbuild"
osource "/home/aj/TpRTOS/zephyr/soc/raspberrypi/Kconfig.sysbuild"
osource "/home/aj/TpRTOS/zephyr/soc/quicklogic/eos_s3/Kconfig.sysbuild"
osource "/home/aj/TpRTOS/zephyr/soc/qemu/virt_riscv/Kconfig.sysbuild"
osource "/home/aj/TpRTOS/zephyr/soc/qemu/malta/Kconfig.sysbuild"
osource "/home/aj/TpRTOS/zephyr/soc/openisa/rv32m1/Kconfig.sysbuild"
osource "/home/aj/TpRTOS/zephyr/soc/nxp/s32/Kconfig.sysbuild"
osource "/home/aj/TpRTOS/zephyr/soc/nxp/rw/Kconfig.sysbuild"
osource "/home/aj/TpRTOS/zephyr/soc/nxp/mcx/Kconfig.sysbuild"
osource "/home/aj/TpRTOS/zephyr/soc/nxp/lpc/Kconfig.sysbuild"
osource "/home/aj/TpRTOS/zephyr/soc/nxp/layerscape/Kconfig.sysbuild"
osource "/home/aj/TpRTOS/zephyr/soc/nxp/kinetis/Kconfig.sysbuild"
osource "/home/aj/TpRTOS/zephyr/soc/nxp/imxrt/Kconfig.sysbuild"
osource "/home/aj/TpRTOS/zephyr/soc/nxp/imx/Kconfig.sysbuild"
osource "/home/aj/TpRTOS/zephyr/soc/nuvoton/numicro/Kconfig.sysbuild"
osource "/home/aj/TpRTOS/zephyr/soc/nuvoton/numaker/Kconfig.sysbuild"
osource "/home/aj/TpRTOS/zephyr/soc/nuvoton/npcx/Kconfig.sysbuild"
osource "/home/aj/TpRTOS/zephyr/soc/nuvoton/npcm/Kconfig.sysbuild"
osource "/home/aj/TpRTOS/zephyr/soc/nordic/Kconfig.sysbuild"
osource "/home/aj/TpRTOS/zephyr/soc/neorv32/Kconfig.sysbuild"
osource "/home/aj/TpRTOS/zephyr/soc/native/inf_clock/Kconfig.sysbuild"
osource "/home/aj/TpRTOS/zephyr/soc/microchip/miv/Kconfig.sysbuild"
osource "/home/aj/TpRTOS/zephyr/soc/microchip/mec/Kconfig.sysbuild"
osource "/home/aj/TpRTOS/zephyr/soc/mediatek/mtk_adsp/Kconfig.sysbuild"
osource "/home/aj/TpRTOS/zephyr/soc/lowrisc/opentitan/Kconfig.sysbuild"
osource "/home/aj/TpRTOS/zephyr/soc/litex/litex_vexriscv/Kconfig.sysbuild"
osource "/home/aj/TpRTOS/zephyr/soc/ite/ec/Kconfig.sysbuild"
osource "/home/aj/TpRTOS/zephyr/soc/intel/raptor_lake/Kconfig.sysbuild"
osource "/home/aj/TpRTOS/zephyr/soc/intel/lakemont/Kconfig.sysbuild"
osource "/home/aj/TpRTOS/zephyr/soc/intel/intel_socfpga_std/Kconfig.sysbuild"
osource "/home/aj/TpRTOS/zephyr/soc/intel/intel_socfpga/Kconfig.sysbuild"
osource "/home/aj/TpRTOS/zephyr/soc/intel/intel_niosv/Kconfig.sysbuild"
osource "/home/aj/TpRTOS/zephyr/soc/intel/intel_ish/Kconfig.sysbuild"
osource "/home/aj/TpRTOS/zephyr/soc/intel/intel_adsp/Kconfig.sysbuild"
osource "/home/aj/TpRTOS/zephyr/soc/intel/elkhart_lake/Kconfig.sysbuild"
osource "/home/aj/TpRTOS/zephyr/soc/intel/atom/Kconfig.sysbuild"
osource "/home/aj/TpRTOS/zephyr/soc/intel/apollo_lake/Kconfig.sysbuild"
osource "/home/aj/TpRTOS/zephyr/soc/intel/alder_lake/Kconfig.sysbuild"
osource "/home/aj/TpRTOS/zephyr/soc/infineon/cat3/Kconfig.sysbuild"
osource "/home/aj/TpRTOS/zephyr/soc/infineon/cat1b/Kconfig.sysbuild"
osource "/home/aj/TpRTOS/zephyr/soc/infineon/cat1a/Kconfig.sysbuild"
osource "/home/aj/TpRTOS/zephyr/soc/gd/gd32/Kconfig.sysbuild"
osource "/home/aj/TpRTOS/zephyr/soc/gaisler/leon3/Kconfig.sysbuild"
osource "/home/aj/TpRTOS/zephyr/soc/gaisler/gr716a/Kconfig.sysbuild"
osource "/home/aj/TpRTOS/zephyr/soc/espressif/Kconfig.sysbuild"
osource "/home/aj/TpRTOS/zephyr/soc/ene/kb1200/Kconfig.sysbuild"
osource "/home/aj/TpRTOS/zephyr/soc/efinix/sapphire/Kconfig.sysbuild"
osource "/home/aj/TpRTOS/zephyr/soc/cdns/xtensa_sample_controller/Kconfig.sysbuild"
osource "/home/aj/TpRTOS/zephyr/soc/cdns/sample_controller32/Kconfig.sysbuild"
osource "/home/aj/TpRTOS/zephyr/soc/cdns/dc233c/Kconfig.sysbuild"
osource "/home/aj/TpRTOS/zephyr/soc/brcm/bcmvk/Kconfig.sysbuild"
osource "/home/aj/TpRTOS/zephyr/soc/brcm/bcm2712/Kconfig.sysbuild"
osource "/home/aj/TpRTOS/zephyr/soc/brcm/bcm2711/Kconfig.sysbuild"
osource "/home/aj/TpRTOS/zephyr/soc/atmel/sam0/Kconfig.sysbuild"
osource "/home/aj/TpRTOS/zephyr/soc/atmel/sam/Kconfig.sysbuild"
osource "/home/aj/TpRTOS/zephyr/soc/aspeed/Kconfig.sysbuild"
osource "/home/aj/TpRTOS/zephyr/soc/arm/Kconfig.sysbuild"
osource "/home/aj/TpRTOS/zephyr/soc/arm/beetle/Kconfig.sysbuild"
osource "/home/aj/TpRTOS/zephyr/soc/andestech/Kconfig.sysbuild"
osource "/home/aj/TpRTOS/zephyr/soc/ambiq/Kconfig.sysbuild"
osource "/home/aj/TpRTOS/zephyr/soc/altr/zephyr_nios2f/Kconfig.sysbuild"
osource "/home/aj/TpRTOS/zephyr/soc/altr/qemu_nios2/Kconfig.sysbuild"
osource "/home/aj/TpRTOS/zephyr/soc/adi/max32/Kconfig.sysbuild"
```

## co2_mes/west.yml
```yaml
manifest:
  remotes:
    - name: zephyrproject-rtos
      url-base: https://github.com/zephyrproject-rtos
    - name: sensirion
      url-base: https://github.com/nobodyguy
    - name: loramac-node
      url-base: https://github.com/zephyrproject-rtos
    - name: semtech
      url-base: https://github.com/zephyrproject-rtos

  projects:
    - name: zephyr
      remote: zephyrproject-rtos
      revision: main
      import:
        name-allowlist:
          - cmsis
          - hal_stm32

    - name: sensirion_zephyr_drivers
      remote: sensirion
      revision: main
      path: modules/sensirion_zephyr_drivers

    #- name: loramac-node
    #  remote: semtech
    #  path: modules/lib/loramac-node
    #  revision: master
      
```
